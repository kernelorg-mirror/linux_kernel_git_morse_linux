## fs/resctrl/Kconfig
```kconfig
config RESCTRL_FS
	bool "CPU Resource Control Filesystem (resctrl)"
	depends on ARCH_HAS_CPU_RESCTRL
	select KERNFS
	select PROC_CPU_RESCTRL               if PROC_FS
	help
	  Resctrl is a filesystem interface to control allocation and
	  monitoring of system resources usage by the CPU.

config RESCTRL_FS_PSEUDO_LOCK
	bool
	help
	  Software mechanism to try and pin data in a cache portion using
	  micro-architecture tricks.
```
